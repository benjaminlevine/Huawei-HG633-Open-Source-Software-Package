## libupnp/Config.in
```kconfig
config BUILD_LIBUPNP
    bool "Support upnp library"
	select BUILD_PTHREAD
    default n

if BUILD_LIBUPNP
menu "ATP DMS Supported Selection"
# ATP all applications

config BUILD_LIBUPNP_V6
    bool "support libupnp ipv6"
    default n
endmenu
endif
```

## linux/2.6.30/arch/arm/mach-sd5115/Kconfig
```kconfig
# define a global config variable

menu "HSAN platform feature"
	  
config MACH_SD5115
	bool "HSAN SD5115 platform"
	select CPU_V7
	select ARM_GIC
	select OUTER_CACHE
	select OUTER_CACHE_SYNC
	select HSAN
	help
	  Include support for the HSAN SD5115 godbox platform.
	  
	  
config HSAN_L2CACHE
	bool "HSAN support L2CACHE"
	default n
	help
	  HSAN support L2CACHE
	  
config HSAN_KCONSOLE
	int "Kernel console( 0 => UART0, 1 => UART1)"
	range 0 1
	default 0
	help
	  Select uart port as the default console used by kernel
config HSAN_EDB_LEVEL
	int "Kernel Early-Debug Level( 0~254, 255 => Disable Early-Debug)"
	range 0 255
	default 255
	help
	  Set the debug level of Early-Debug, low level will cause more debug message
config DEFAULT_BUSCLK
	int "DEFAULT_BUSCLK"
	default "50000000"
	help
      	Default AHB clock rate

endmenu
```

## linux/2.6.30/arch/arm/mach-sd56xx/Kconfig
```kconfig
# define a global config variable

menu "HSAN platform feature"
	  
config MACH_SD56XX
	bool "HSAN SD56XX platform"
	select CPU_V7
	select ARM_GIC
	select OUTER_CACHE
	select OUTER_CACHE_SYNC
	select HSAN
	help
	  Include support for the HSAN SD56XX godbox platform.
	  
config HSAN_L2CACHE
	bool "HSAN support L2CACHE"
	default n
	help
	  HSAN support L2CACHE
	  
config HSAN_KCONSOLE
	int "Kernel console( 0 => UART0, 1 => UART1)"
	range 0 1
	default 0
	help
	  Select uart port as the default console used by kernel
config HSAN_EDB_LEVEL
	int "Kernel Early-Debug Level( 0~254, 255 => Disable Early-Debug)"
	range 0 255
	default 255
	help
	  Set the debug level of Early-Debug, low level will cause more debug message
config DEFAULT_BUSCLK
	int "DEFAULT_BUSCLK"
	default "100000000"
	help
      	Default AHB clock rate

endmenu
```

## linux/2.6.30/drivers/mtd/hinand/Kconfig
```kconfig
#
# drivers/mtd/hinand/Kconfig
#

menu "HSAN NAND device Support"
	 
config MTD_HSAN_NFC
    bool "Support HSAN NAND Controller device"
    depends on HSAN
    select YAFFS_FS
    select MISC_FILESYSTEMS
    select MTD_BLOCK
    select YAFFS_YAFFS2
    help
	 HSAN NAND Controller device Support
	 
config MTD_HSAN_NFC_REG_BASE_ADDRESS
	hex "nand controller's register base address"
	depends on MTD_HSAN_NFC
	default 0x10A30000
	help
	  register base address of nand controller

config MTD_HSAN_NFC_REG_BASE_ADDRESS_LEN
	hex "nand controller's register base address len"
	depends on MTD_HSAN_NFC
	default 0x100
	help
	  register base address len of nand controller

config MTD_HSAN_NFC_BUFFER_BASE_ADDRESS
	hex "nand controller's buffer base address"
	depends on MTD_HSAN_NFC
	default 0x20000000
	help
	  buffer base address of nand controller
	
config MTD_HSAN_NFC_BUFFER_BASE_ADDRESS_LEN
	hex "nand controller's buffer base address len"
	depends on MTD_HSAN_NFC
	default 0x2400
	help
	  buffer base address len of nand controller

endmenu
```

## linux/2.6.30/drivers/mtd/hisfc/Kconfig
```kconfig
#
# drivers/mtd/hisfc/Kconfig
#

menu "HSAN SFC Support"
	 
config MTD_HSAN_SFC
    bool "Support HSAN SPIFLASH Controller"
    depends on HSAN
    select YAFFS_FS
    select MISC_FILESYSTEMS
    select MTD_BLOCK
    select YAFFS_YAFFS2
    help
	 HSAN SPIFLASH Controller Support

config MTD_HSAN_SFC_CHIPNUM
	hex "spi chip number of your board"
	depends on MTD_HSAN_SFC
	default 2
	help
	  how many spi chips is used on your board?
	  
config MTD_HSAN_SFC_REG_BASE_ADDRESS
	hex "spi controller's register base address"
	depends on MTD_HSAN_SFC
	default 0x10A20000
	help
	  register base address of spi controller

config MTD_HSAN_SFC_REG_BASE_ADDRESS_LEN
	hex "spi controller's register base address len"
	depends on MTD_HSAN_SFC
	default 0x100
	help
	  register base address len of spi controller

config MTD_HSAN_SFC_CS0_BUFFER_BASE_ADDRESS
	hex "spi controller's cs0 buffer base address"
	depends on MTD_HSAN_SFC
	default 0x18000000
	help
	  buffer base address of spi controller cs0
	
config MTD_HSAN_SFC_CS0_BUFFER_BASE_ADDRESS_LEN
	hex "spi controller's cs0 buffer base address len"
	depends on MTD_HSAN_SFC
	default 0x4000000
	help
	  buffer base address len of spi controller cs0
	  
config MTD_HSAN_SFC_CS1_BUFFER_BASE_ADDRESS
	hex "spi controller's cs1 buffer base address"
	depends on MTD_HSAN_SFC
	default 0x1c000000
	help
	  buffer base address of spi controller cs1
	
config MTD_HSAN_SFC_CS1_BUFFER_BASE_ADDRESS_LEN
	hex "spi controller's cs1 buffer base address len"
	depends on MTD_HSAN_SFC
	default 0x4000000
	help
	  buffer base address len of spi controller cs1
	  
endmenu
```

## linux/2.6.30/drivers/usb/host/Kconfig.hiusb
```kconfig
#
# HSAN usb Host Controller Drivers
#
if HSAN

config USB_HSAN_XHCI
	bool "HSAN usb-xhci usb host device support"
	depends on HSAN
	default y

config USB_HSAN_XHCI_IOBASE
	hex "HSAN usb-xhci IO address"
	depends on (USB_HSAN_XHCI)
	default "0x10A50000"

config USB_HSAN_XHCI_IOSIZE
	hex "HSAN usb-xhci IO size"
	depends on (USB_HSAN_XHCI)
	default "0x00010000"
	help
	  default is 0x10000.

config USB_HSAN_XHCI_IRQNUM
	int "HSAN usb-xhci irq number"
	depends on (USB_HSAN_XHCI)
	default "71"


config USB_HSAN_EHCI
	bool "HSAN usb-ehci usb host device support"
	depends on HSAN
	default y

config USB_HSAN_EHCI_IOBASE
	hex "HSAN usb-ehci IO address"
	depends on USB_HSAN_EHCI
	default "0x10A40000"

config USB_HSAN_EHCI_IOSIZE
	hex "HSAN usb-ehci IO size"
	depends on USB_HSAN_EHCI
	default "0x00010000"
	help
	  default is 0x10000.

config USB_HSAN_EHCI_IRQNUM
	int "HSAN usb-ehci irq number"
	depends on USB_HSAN_EHCI
	default "71"

config USB_HSAN_OHCI
	bool "HSAN usb-ohci usb host device support"
	depends on HSAN
	default y

config USB_HSAN_OHCI_IOBASE
	hex "HSAN usb-ohci IO address"
	depends on USB_HSAN_OHCI
	default "0x10A50000"

config USB_HSAN_OHCI_IOSIZE
	hex "HSAN usb-ohci IO size"
	depends on USB_HSAN_OHCI
	default "0x00010000"
	help
	  default is 0x10000.

config USB_HSAN_OHCI_IRQNUM
	int "HSAN usb-ohci irq number"
	depends on USB_HSAN_OHCI
	default "70"

config ATP_USB_ADAPTOR
	bool "atp usb adaptor"
	default y

endif
```
